//*******************************************************************************
//----------------本例程仅供学习使用，未经作者允许，不得用于其他用途。-----------
//------------------------版权所有，仿冒必究！-----------------------------------
//----------------1.开发环境:Arduino IDE-----------------------------------------
//----------------2.测试使用开发板型号：Arduino Leonardo or Arduino UNO R3-------
//----------------3.单片机使用晶振：16M------------------------------------------
//----------------4.淘宝网址：http://xmdzpj.taobao.com---------------------------
//----------------5.作者：真红炎神---------------------------------------------
//*******************************************************************************/

int buzzer=3;     //设置控制蜂鸣器的数字IO脚
void setup() 
{ 
pinMode(buzzer,OUTPUT);//设置数字IO脚模式，OUTPUT为辒出 
} 
void loop() 
{ 
unsigned char i,j;//定义变量
while(1) 
{ 
for(i=0;i<80;i++)//输出一个频率的声音
{ 
digitalWrite(buzzer,HIGH);//发声音
delay(1);//延时1ms 
digitalWrite(buzzer,LOW);//不发声音
delay(1);//延时ms 
} 
for(i=0;i<100;i++)//输出另一个频率的声音 
{ 
digitalWrite(buzzer,HIGH);//发声音
delay(2);//延时2ms 
digitalWrite(buzzer,LOW);//不发声音
delay(2);//延时2ms 
} 
} 
}

